#include "DisplayManager.h"

DisplayManager::DisplayManager(): display(SCREEN_WIDTH, SCREEN_HEIGHT, &Wire, -1), canvas(BAR_BITMAP_WIDTH, BAR_BITMAP_HEIGHT), lastTick(0), dotCount(1) {}

bool DisplayManager::begin() {
  Wire.begin(SDA_PIN, SCL_PIN);

  if(!display.begin(SSD1306_SWITCHCAPVCC, 0x3C)) {
      return false;
  }

  display.clearDisplay();
  display.setTextSize(1);
  display.setTextColor(WHITE);
  display.display();

  return true;
}

void DisplayManager::clear() {
  display.clearDisplay();
}

void DisplayManager::update() {
  display.display();
}

void DisplayManager::drawStringCentered(const char *buf, int x, int y) {
  int16_t x1, y1;
  uint16_t w, h;
  display.getTextBounds(buf, 0, 0, &x1, &y1, &w, &h);
  display.setCursor(x - w / 2 - x1, y - h / 2 - y1);
  display.print(buf);
}

void DisplayManager::drawBitmapCentered(const unsigned char *bitmap, int x, int y) {
  int bitmapWidth = 32; 
  int bitmapHeight = 32;

  int x1 = (x - bitmapWidth) / 2;
  int y1 = (y - bitmapHeight) / 2;

  display.drawBitmap(x1, y1, bitmap, bitmapWidth, bitmapHeight, WHITE);
}

void DisplayManager::showLoadingBar(int progress) {
  canvas.fillScreen(0);
  canvas.drawBitmap(0, 0, bitmap_loading_bar, BAR_BITMAP_WIDTH, BAR_BITMAP_HEIGHT, WHITE);
  canvas.fillRect(5, 14, progress, 4, 1);

  int x_pos = (SCREEN_WIDTH - BAR_BITMAP_WIDTH) / 2;
  int y_pos = (SCREEN_HEIGHT - BAR_BITMAP_HEIGHT) / 2 + 10;
  display.drawBitmap(x_pos, y_pos, canvas.getBuffer(), BAR_BITMAP_WIDTH, BAR_BITMAP_HEIGHT, WHITE);
  display.display();
}

void DisplayManager::waitingForConnection() {
  String message = "Oczekiwanie";

  if (millis() - lastTick > 500) {
    lastTick = millis();
    dotCount++;

    if (dotCount > 3) dotCount = 1;
  }

  for (int i = 0; i < dotCount; i++) {
    message += ".";
  }

  drawStringCentered(message.c_str(), 64, 32);
}

const unsigned char DisplayManager::bitmap_bt[] PROGMEM = {
  0x00, 0x00, 0x00, 0x00, 0x00, 0x01, 0x80, 0x00, 0x00, 0x03, 0xc0, 0x00, 0x00, 0x03, 0xe0, 0x00,
  0x00, 0x03, 0xf0, 0x00, 0x00, 0x03, 0xf8, 0x00, 0x03, 0x03, 0xfc, 0x00, 0x07, 0x83, 0xfe, 0x00,
  0x07, 0xc3, 0xdf, 0x00, 0x03, 0xe3, 0xcf, 0x80, 0x01, 0xf3, 0xc7, 0x80, 0x00, 0xfb, 0xcf, 0x80,
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  0x00, 0x03, 0xe0, 0x00, 0x00, 0x03, 0xc0, 0x00, 0x00, 0x01, 0x80, 0x00, 0x00, 0x00, 0x00, 0x00
};

const unsigned char DisplayManager::bitmap_wifi[] PROGMEM = {
  0x00, 0x00, 0x00, 0x00, 0x00, 0x00, 0x00, 0x00, 0x00, 0x00, 0x00, 0x00, 0x00, 0x00, 0x00, 0x00,
  0x00, 0x00, 0x00, 0x00, 0x00, 0x00, 0x00, 0x00, 0x00, 0x00, 0x00, 0x00, 0x00, 0x00, 0x00, 0x00,
  0x00, 0x00, 0x00, 0x00, 0x00, 0x0f, 0xf0, 0x00, 0x00, 0x7f, 0xfe, 0x00, 0x01, 0xff, 0xff, 0x80,
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  0x00, 0x07, 0xe0, 0x00, 0x00, 0x07, 0xe0, 0x00, 0x00, 0x03, 0xc0, 0x00, 0x00, 0x00, 0x00, 0x00
};

const unsigned char DisplayManager::bitmap_loading_bar[] PROGMEM = {
  0x00, 0x00, 0x00, 0x00, 0x00, 0x00, 0x00, 0x00, 0x00, 0x00, 0x00, 0x00, 0x00, 0x00, 0x00, 0x00,
  0x00, 0x00, 0x00, 0x00, 0x00, 0x00, 0x00, 0x00, 0x00, 0x00, 0x00, 0x00, 0x00, 0x00, 0x00, 0x00,
  0x00, 0x00, 0x00, 0x00, 0x00, 0x00, 0x00, 0x00, 0x00, 0x00, 0x00, 0x00, 0x00, 0x00, 0x00, 0x00,
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  0x00, 0x00, 0x00, 0x00, 0x00, 0x00, 0x00, 0x00, 0x00, 0x00, 0x00, 0x00, 0x00, 0x00, 0x00, 0x00
};